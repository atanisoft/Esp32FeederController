## firmware/sdkconfig.defaults
```kconfig
#
# SDK configuration
#
CONFIG_ESPTOOLPY_FLASHSIZE_4MB=y

#
# Log output
#
CONFIG_LOG_DEFAULT_LEVEL_WARN=y
CONFIG_LOG_MAXIMUM_LEVEL_VERBOSE=y

#
# Heap memory debugging
#
CONFIG_HEAP_POISONING_LIGHT=y

#
# Partition Table
#
CONFIG_PARTITION_TABLE_SINGLE_APP=y

#
# Compiler options
#
CONFIG_COMPILER_STACK_CHECK_MODE_NORM=y
CONFIG_COMPILER_STACK_CHECK=y
CONFIG_COMPILER_OPTIMIZATION_DEFAULT=y
CONFIG_COMPILER_CXX_EXCEPTIONS=y
CONFIG_COMPILER_CXX_RTTI=y

#
# ESP32 Specific
#
# NOTE: ESP-IDF defaults to 160Mhz mode!
CONFIG_ESP32_DEFAULT_CPU_FREQ_240=y
CONFIG_ESP32_DEBUG_OCDAWARE=n
CONFIG_ESP32_ULP_COPROC_ENABLED=y

#
# Bootloader configuratino
#
CONFIG_BOOTLOADER_LOG_LEVEL_INFO=y

#
# FreeRTOS configuration
#
CONFIG_FREERTOS_HZ=1000
CONFIG_FREERTOS_SUPPORT_STATIC_ALLOCATION=y
CONFIG_FREERTOS_DEBUG_OCDAWARE=n
CONFIG_FREERTOS_ENABLE_BACKWARD_COMPATIBILITY=y

#
# LwIP configuration
#
CONFIG_LWIP_SO_RCVBUF=y
CONFIG_LWIP_LOCAL_HOSTNAME="esp32cs"
# disable IRAM optimization due to https://github.com/espressif/esp-idf/issues/5734
CONFIG_LWIP_IRAM_OPTIMIZATION=n
CONFIG_LWIP_MAX_SOCKETS=16
CONFIG_LWIP_ETHARP_TRUST_IP_MAC=y
CONFIG_LWIP_DHCP_RESTORE_LAST_IP=y
CONFIG_LWIP_MAX_LISTENING_TCP=10
CONFIG_LWIP_TCPIP_TASK_AFFINITY_CPU1=y
# workaround for https://github.com/espressif/esp-idf/issues/7742
CONFIG_LWIP_DHCP_OPTIONS_LEN=128

#
# WiFi configuration
#
CONFIG_ESP32_WIFI_NVS_ENABLED=n
CONFIG_ESP32_WIFI_STATIC_RX_BUFFER_NUM=16
CONFIG_ESP32_WIFI_RX_BA_WIN=16
CONFIG_ESP32_WIFI_TASK_PINNED_TO_CORE_0=y

#
# Task stack configuration
#
CONFIG_ESP_MAIN_TASK_STACK_SIZE=4096
CONFIG_ESP_IPC_TASK_STACK_SIZE=2048
CONFIG_ESP_SYSTEM_EVENT_TASK_STACK_SIZE=2816

#
# Watchdog configuration
#
CONFIG_ESP_TASK_WDT=n
```
